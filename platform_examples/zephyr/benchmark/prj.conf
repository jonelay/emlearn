## CMakeLists.txt
```
cmake_minimum_required(VERSION 3.20.0)

find_package(Zephyr REQUIRED HINTS $ENV{ZEPHYR_BASE})
project(emlearn_benchmark)

# Find emlearn headers using Python
# This works both when building in-place and when app is copied to temp directory
execute_process(
    COMMAND ${Python3_EXECUTABLE} -c "import emlearn; print(emlearn.includedir)"
    OUTPUT_VARIABLE EMLEARN_INCLUDE_DIR
    OUTPUT_STRIP_TRAILING_WHITESPACE
    RESULT_VARIABLE EMLEARN_RESULT
)
if(NOT EMLEARN_RESULT EQUAL 0 OR NOT EXISTS "${EMLEARN_INCLUDE_DIR}")
    # Fallback: try relative path for in-place builds
    set(EMLEARN_INCLUDE_DIR "${CMAKE_CURRENT_SOURCE_DIR}/../../../emlearn")
endif()
message(STATUS "emlearn include dir: ${EMLEARN_INCLUDE_DIR}")

target_include_directories(app PRIVATE ${EMLEARN_INCLUDE_DIR})

file(GLOB app_sources src/*.c)
target_sources(app PRIVATE ${app_sources})

# CMSIS-DSP optimization (for tree voting vectorization)
if(CONFIG_EMLEARN_USE_CMSIS_DSP)
    target_compile_definitions(app PRIVATE EML_TREES_CMSIS_DSP=1)
endif()

# Pointer-based tree traversal (alternative to index-based)
if(CONFIG_EMLEARN_POINTER_TRAVERSAL)
    target_compile_definitions(app PRIVATE EML_TREES_USE_POINTER_TRAVERSAL=1)
endif()
```

## Kconfig
```
# emlearn benchmark Kconfig options

mainmenu "emlearn Benchmark"

source "Kconfig.zephyr"

menuconfig EMLEARN_BENCHMARK
	bool "emlearn benchmark options"
	default y
	help
	  Configuration options for emlearn benchmarking.

if EMLEARN_BENCHMARK

choice EMLEARN_TIMING_SOURCE
	prompt "Timing source"
	default EMLEARN_TIMING_DWT if CPU_CORTEX_M3 || CPU_CORTEX_M4 || CPU_CORTEX_M7 || CPU_CORTEX_M33
	default EMLEARN_TIMING_SYSTICK
	help
	  Select the timing source for benchmark measurements.

config EMLEARN_TIMING_DWT
	bool "DWT cycle counter (Cortex-M3+)"
	depends on CPU_CORTEX_M3 || CPU_CORTEX_M4 || CPU_CORTEX_M7 || CPU_CORTEX_M33
	help
	  Use the DWT (Data Watchpoint and Trace) cycle counter for
	  cycle-accurate timing. Available on Cortex-M3, M4, M7, M33.
	  Provides the most accurate timing measurements.

config EMLEARN_DWT_CPU_FREQ_HZ
	int "DWT CPU frequency in Hz"
	default 64000000
	depends on EMLEARN_TIMING_DWT
	help
	  CPU frequency for DWT cycle counter timing calculations.
	  DWT counts CPU cycles, not system clock ticks. On many platforms,
	  CONFIG_SYS_CLOCK_HW_CYCLES_PER_SEC reflects a low-frequency RTC
	  or timer, not the actual CPU frequency.

	  Common values:
	  - nRF52832/nRF52840: 64000000 (64 MHz)
	  - STM32F4: 84000000-168000000 (varies by model)
	  - STM32F7: 216000000 (216 MHz)

config EMLEARN_TIMING_SYSTICK
	bool "Systick timer"
	help
	  Use the Zephyr kernel systick timer for timing measurements.
	  Resolution depends on CONFIG_SYS_CLOCK_TICKS_PER_SEC.
	  Works on all platforms including Cortex-M0/M0+.

config EMLEARN_TIMING_POSIX
	bool "POSIX clock_gettime (native_sim)"
	depends on ARCH_POSIX
	help
	  Use POSIX clock_gettime(CLOCK_MONOTONIC) for high-resolution
	  timing on native_sim and other POSIX-based targets.
	  Provides nanosecond precision using host system clock.

endchoice

config EMLEARN_BENCHMARK_ITERATIONS
	int "Number of benchmark iterations"
	default 100
	range 10 10000
	help
	  Number of inference iterations to run for timing measurements.

config EMLEARN_BENCHMARK_WARMUP
	int "Number of warmup iterations"
	default 10
	range 0 100
	help
	  Number of warmup iterations to run before timing.
	  Helps stabilize cache and branch predictor state.

config EMLEARN_BENCHMARK_STRUCTURED_OUTPUT
	bool "Enable structured output markers"
	default y
	help
	  Output results with machine-readable markers (BENCHMARK:, RESULT:)
	  for automated parsing by test infrastructure.

config EMLEARN_BENCHMARK_MICRO
	bool "Run micro-benchmarks for timing validation"
	default n
	help
	  Run isolated micro-benchmarks before the main model benchmark.
	  Measures individual operations (expf, sigmoid, integer ops, FP ops,
	  FP division) to validate timing assumptions and CPI baselines.

	  Output format:
	    RESULT:MICRO:<name> avg_cycles=<cyc> iterations=<n>

	  Available benchmarks:
	    - EXPF: Isolated expf() cost (~50-200 cycles)
	    - SIGMOID: Full sigmoid 1/(1+exp(-x)) cost (~60-250 cycles)
	    - INT_OPS: Integer add/xor/and ops (~1 CPI baseline)
	    - FP_OPS: FP add/mul ops (~1 CPI on FPU)
	    - FP_DIV: FP division (~14 cycles on Cortex-M4F)

	  Useful for:
	    - Validating GBT sigmoid overhead hypothesis
	    - Establishing CPI baselines for different instruction types
	    - Cross-validating DWT timing with instruction counts

config EMLEARN_USE_CMSIS_DSP
	bool "Use CMSIS-DSP optimized functions"
	default n
	depends on CPU_CORTEX_M
	select CMSIS_DSP
	help
	  Enable CMSIS-DSP optimized implementations for tree voting
	  accumulation and normalization. Provides ~2.3x speedup for
	  soft voting with n_classes >= 3.

	  Requires CMSIS-DSP module (automatically selected).

config EMLEARN_BENCHMARK_PREDICT_PROBA
	bool "Benchmark predict_proba instead of predict"
	default n
	help
	  Measure probability prediction latency instead of class prediction.
	  For binary GBT, this exercises sigmoid computation.
	  For multi-class GBT, this exercises softmax computation.

	  Useful for measuring the overhead of probability output vs class labels.

config EMLEARN_POINTER_TRAVERSAL
	bool "Use pointer-based tree traversal"
	default n
	help
	  Use pointer-based tree traversal instead of index-based.
	  May improve performance on some architectures by reducing
	  memory access latency. Target 5-15% improvement on Cortex-M4F.

	  Default is index-based traversal which uses array indexing.

endif # EMLEARN_BENCHMARK
```

## west.yml
```
# Copyright (c) 2024 emlearn
# SPDX-License-Identifier: MIT

manifest:
  remotes:
    - name: zephyrproject-rtos
      url-base: https://github.com/zephyrproject-rtos

  projects:
    - name: zephyr
      remote: zephyrproject-rtos
      revision: v4.2.1
      import:
        name-allowlist:
          - cmsis_6      # required by ARM port
          - hal_nordic   # required by Nordic boards

    - name: emlearn
      url: https://github.com/emlearn/emlearn
      revision: master
```

## prj.conf
```kconfig
# System tick rate - use 1kHz for millisecond resolution
# Note: nRF52 RTC runs at 32768 Hz, so 1MHz is not possible
# DWT cycle counter provides higher resolution for actual timing measurements
CONFIG_SYS_CLOCK_TICKS_PER_SEC=1000

# Enable console output
CONFIG_CONSOLE=y
CONFIG_UART_CONSOLE=y

# Disable features we don't need to reduce size
CONFIG_BOOT_BANNER=n
CONFIG_PRINTK=y

# emlearn benchmark configuration (defaults)
CONFIG_EMLEARN_BENCHMARK=y
CONFIG_EMLEARN_BENCHMARK_ITERATIONS=100
CONFIG_EMLEARN_BENCHMARK_WARMUP=10
CONFIG_EMLEARN_BENCHMARK_STRUCTURED_OUTPUT=y
```

## boards/native_sim.conf
```kconfig
# Native Sim configuration
# Runs natively on host with host FPU for floating-point operations
CONFIG_EMLEARN_BENCHMARK_STRUCTURED_OUTPUT=y

# Use POSIX clock_gettime for high-resolution timing
CONFIG_EMLEARN_TIMING_POSIX=y

# Native console - use POSIX_ARCH_CONSOLE (not UART) for native_sim
CONFIG_CONSOLE=y
CONFIG_UART_CONSOLE=n
CONFIG_POSIX_ARCH_CONSOLE=y
```

## boards/nrf52dk_nrf52832.conf
```kconfig
# nRF52 DK (Cortex-M4) configuration
# Uses DWT cycle counter for accurate timing
CONFIG_EMLEARN_TIMING_DWT=y
CONFIG_EMLEARN_BENCHMARK_STRUCTURED_OUTPUT=y

# Enable RTT for output capture (preferred over UART)
CONFIG_USE_SEGGER_RTT=y
CONFIG_RTT_CONSOLE=y
CONFIG_UART_CONSOLE=n
```

## boards/renode_nrf52840.conf
```kconfig
# Renode nRF52832/nRF52840 emulator configuration
#
# Uses DWT cycle counter for accurate timing. Requires:
# 1. Custom platform file with DWT: boards/nrf52840_dwt.repl
# 2. Small quantum for cycle-level timing:
#    emulation SetGlobalQuantum "00:00:00.000000016"  # 16ns = 1 cycle at 64MHz
#
# Build: west build --board nrf52840dk/nrf52840 -d build platform_examples/zephyr/benchmark
# Run:   See boards/renode_nrf52840.resc

CONFIG_EMLEARN_TIMING_DWT=y
CONFIG_EMLEARN_BENCHMARK_STRUCTURED_OUTPUT=y

# UART output for Renode (not RTT which requires J-Link)
CONFIG_USE_SEGGER_RTT=n
CONFIG_RTT_CONSOLE=n
CONFIG_UART_CONSOLE=y

# Required for UART to work in Renode with nRF52840 UARTE
CONFIG_UART_NRFX_UARTE_NO_IRQ=y

# Use standard tick rate - 1MHz causes crashes in Renode
# nRF52840 uses RTC for system clock at 32768 Hz
CONFIG_SYS_CLOCK_TICKS_PER_SEC=32768

# Stack size for benchmark
CONFIG_MAIN_STACK_SIZE=8192
```

## src/main.c
```c
/*
 * emlearn benchmark for Zephyr RTOS
 *
 * Measures inference latency for tree ensemble models.
 * Reports timing statistics over multiple iterations.
 *
 * Output format (with CONFIG_EMLEARN_BENCHMARK_STRUCTURED_OUTPUT=y):
 *   BENCHMARK:START
 *   BENCHMARK:CONFIG board=<board> timing=<dwt|systick> freq=<hz>
 *   BENCHMARK:MODEL name=<name> features=<n>
 *   RESULT:INFERENCE min_ns=<ns> max_ns=<ns> avg_ns=<ns> min_cycles=<cyc> avg_cycles=<cyc> iterations=<n>
 *   BENCHMARK:END status=<ok|error>
 *
 * Micro-benchmarks (with CONFIG_EMLEARN_BENCHMARK_MICRO=y):
 *   RESULT:MICRO:<name> avg_cycles=<cyc> iterations=<n>
 *   Available micro-benchmarks: EXPF, SIGMOID, INT_OPS, FP_OPS, FP_DIV
 */

#include <zephyr/kernel.h>
#include <zephyr/sys/barrier.h>
#include <stdint.h>
#include <stdio.h>
#include <math.h>

#include "eml_mcu_timing.h"
#include "eml_trees.h"
#include "eml_gbtrees.h"
#include "benchmark_model.h"
#include "benchmark_model_testdata.h"

/* Configuration from Kconfig */
#ifndef CONFIG_EMLEARN_BENCHMARK_ITERATIONS
#define CONFIG_EMLEARN_BENCHMARK_ITERATIONS 100
#endif

#ifndef CONFIG_EMLEARN_BENCHMARK_WARMUP
#define CONFIG_EMLEARN_BENCHMARK_WARMUP 50
#endif

/* Micro-benchmark iterations (fixed, not configurable) */
#define MICRO_ITERATIONS 100
#define MICRO_OPS_PER_ITERATION 100  /* 100 ops dilutes ~5 cycle loop overhead to <5% */

/* Statistics tracking (nanoseconds for precision) */
struct benchmark_stats {
    uint32_t min_ns;
    uint32_t max_ns;
    uint64_t total_ns;
    uint32_t min_cycles;
    uint32_t max_cycles;
    uint64_t total_cycles;
    int count;
};

static void stats_init(struct benchmark_stats *stats)
{
    stats->min_ns = UINT32_MAX;
    stats->max_ns = 0;
    stats->total_ns = 0;
    stats->min_cycles = UINT32_MAX;
    stats->max_cycles = 0;
    stats->total_cycles = 0;
    stats->count = 0;
}

static void stats_update(struct benchmark_stats *stats, uint32_t elapsed_ns, uint32_t elapsed_cycles)
{
    if (elapsed_ns < stats->min_ns) {
        stats->min_ns = elapsed_ns;
    }
    if (elapsed_ns > stats->max_ns) {
        stats->max_ns = elapsed_ns;
    }
    if (elapsed_cycles < stats->min_cycles) {
        stats->min_cycles = elapsed_cycles;
    }
    if (elapsed_cycles > stats->max_cycles) {
        stats->max_cycles = elapsed_cycles;
    }
    stats->total_ns += elapsed_ns;
    stats->total_cycles += elapsed_cycles;
    stats->count++;
}

static void stats_print_structured(const struct benchmark_stats *stats, const char *label)
{
    uint32_t avg_ns = stats->count > 0 ? (uint32_t)(stats->total_ns / stats->count) : 0;
    uint32_t avg_cycles = stats->count > 0 ? (uint32_t)(stats->total_cycles / stats->count) : 0;

#ifdef CONFIG_EMLEARN_BENCHMARK_STRUCTURED_OUTPUT
    printf("RESULT:%s min_ns=%u max_ns=%u avg_ns=%u min_cycles=%u avg_cycles=%u iterations=%d\n",
           label,
           stats->min_ns,
           stats->max_ns,
           avg_ns,
           stats->min_cycles,
           avg_cycles,
           stats->count);
#else
    printf("BENCHMARK %s: min=%u ns, max=%u ns, avg=%u ns, min_cycles=%u, iterations=%d\n",
           label,
           stats->min_ns,
           stats->max_ns,
           avg_ns,
           stats->min_cycles,
           stats->count);
#endif
}

static void stats_print_legacy(const struct benchmark_stats *stats, const char *label)
{
    uint32_t avg_ns = stats->count > 0 ? (uint32_t)(stats->total_ns / stats->count) : 0;

    printf("BENCHMARK %s: min=%u ns, max=%u ns, avg=%u ns, iterations=%d\n",
           label,
           stats->min_ns,
           stats->max_ns,
           avg_ns,
           stats->count);
}

/*
 * Marker functions for GDB breakpoint-controlled execution tracing.
 * These must be non-inlined so GDB can set breakpoints on them.
 * The nop prevents the compiler from optimizing them away entirely.
 */
void __attribute__((noinline, used)) benchmark_loop_start(void)
{
    __asm__ volatile("nop");
}

void __attribute__((noinline, used)) benchmark_loop_end(void)
{
    __asm__ volatile("nop");
}

/*
 * Phase marker functions for overhead isolation in trace analysis.
 * These mark transitions between boot, warmup, benchmark, and output phases.
 * Addresses can be extracted with nm/objdump to count instructions per phase.
 */
void __attribute__((noinline, used)) marker_boot_end(void)
{
    __asm__ volatile("nop");
}

void __attribute__((noinline, used)) marker_warmup_start(void)
{
    __asm__ volatile("nop");
}

void __attribute__((noinline, used)) marker_warmup_end(void)
{
    __asm__ volatile("nop");
}

void __attribute__((noinline, used)) marker_benchmark_start(void)
{
    __asm__ volatile("nop");
}

void __attribute__((noinline, used)) marker_benchmark_end(void)
{
    __asm__ volatile("nop");
}

/*
 * Micro-benchmark functions for validating timing assumptions.
 * Each measures a specific operation type to establish CPI baselines.
 */
#ifdef CONFIG_EMLEARN_BENCHMARK_MICRO

/* Prevent constant folding of test values */
static volatile float micro_test_val = -1.5f;
static volatile uint32_t micro_test_int = 12345;

static void run_micro_expf(struct eml_timing_ctx *ctx)
{
    struct eml_timing_sample sample;
    uint64_t total_cycles = 0;
    volatile float result = 0.0f;
    float x;

    /* Warm up */
    for (int i = 0; i < MICRO_ITERATIONS / 10; i++) {
        result = expf(micro_test_val + (float)i * 0.001f);
    }

    /* Benchmark */
    for (int i = 0; i < MICRO_ITERATIONS; i++) {
        x = micro_test_val + (float)i * 0.001f;

        eml_timing_start(ctx, &sample);
        for (int j = 0; j < MICRO_OPS_PER_ITERATION; j++) {
            result = expf(x);
            x = result * 0.1f + micro_test_val;
        }
        eml_timing_stop(ctx, &sample);

        total_cycles += eml_timing_cycles(ctx, &sample);
        __asm__ volatile("" : : "r"(result) : "memory");
    }

    uint32_t avg_cycles = (uint32_t)(total_cycles / (MICRO_ITERATIONS * MICRO_OPS_PER_ITERATION));
    printf("RESULT:MICRO:EXPF avg_cycles=%u iterations=%d\n", avg_cycles, MICRO_ITERATIONS * MICRO_OPS_PER_ITERATION);
}

static void run_micro_sigmoid(struct eml_timing_ctx *ctx)
{
    struct eml_timing_sample sample;
    uint64_t total_cycles = 0;
    volatile float result = 0.0f;
    float x;

    /* Warm up */
    for (int i = 0; i < MICRO_ITERATIONS / 10; i++) {
        x = micro_test_val + (float)i * 0.001f;
        result = 1.0f / (1.0f + expf(-x));
    }

    /* Benchmark: full sigmoid = 1/(1+exp(-x)) */
    for (int i = 0; i < MICRO_ITERATIONS; i++) {
        x = micro_test_val + (float)i * 0.001f;

        eml_timing_start(ctx, &sample);
        for (int j = 0; j < MICRO_OPS_PER_ITERATION; j++) {
            result = 1.0f / (1.0f + expf(-x));
            x = result - 0.5f + micro_test_val;
        }
        eml_timing_stop(ctx, &sample);

        total_cycles += eml_timing_cycles(ctx, &sample);
        __asm__ volatile("" : : "r"(result) : "memory");
    }

    uint32_t avg_cycles = (uint32_t)(total_cycles / (MICRO_ITERATIONS * MICRO_OPS_PER_ITERATION));
    printf("RESULT:MICRO:SIGMOID avg_cycles=%u iterations=%d\n", avg_cycles, MICRO_ITERATIONS * MICRO_OPS_PER_ITERATION);
}

static void run_micro_int_ops(struct eml_timing_ctx *ctx)
{
    struct eml_timing_sample sample;
    uint64_t total_cycles = 0;
    volatile uint32_t result = 0;
    uint32_t x;

    /* Benchmark: simple integer arithmetic (should be ~1 CPI) */
    for (int i = 0; i < MICRO_ITERATIONS; i++) {
        x = micro_test_int + i;

        eml_timing_start(ctx, &sample);
        for (int j = 0; j < MICRO_OPS_PER_ITERATION; j++) {
            result = x + (j * 3);
            x = result ^ 0x5555;
            result = x - j;
            x = result | (j << 2);
            result = x & 0xFFFF;
        }
        eml_timing_stop(ctx, &sample);

        total_cycles += eml_timing_cycles(ctx, &sample);
        __asm__ volatile("" : : "r"(result) : "memory");
    }

    /* 5 ops per inner loop iteration */
    uint32_t avg_cycles = (uint32_t)(total_cycles / (MICRO_ITERATIONS * MICRO_OPS_PER_ITERATION * 5));
    printf("RESULT:MICRO:INT_OPS avg_cycles=%u iterations=%d\n", avg_cycles, MICRO_ITERATIONS * MICRO_OPS_PER_ITERATION * 5);
}

static void run_micro_fp_ops(struct eml_timing_ctx *ctx)
{
    struct eml_timing_sample sample;
    uint64_t total_cycles = 0;
    volatile float result = 0.0f;
    float x;

    /* Benchmark: simple FP add/mul (should be ~1 CPI on FPU) */
    for (int i = 0; i < MICRO_ITERATIONS; i++) {
        x = (float)micro_test_int * 0.001f + (float)i;

        eml_timing_start(ctx, &sample);
        for (int j = 0; j < MICRO_OPS_PER_ITERATION; j++) {
            result = x + (float)j;
            x = result * 1.1f;
            result = x - 0.5f;
            x = result * 0.9f;
            result = x + 1.0f;
        }
        eml_timing_stop(ctx, &sample);

        total_cycles += eml_timing_cycles(ctx, &sample);
        __asm__ volatile("" : : "r"(result) : "memory");
    }

    /* 5 ops per inner loop iteration */
    uint32_t avg_cycles = (uint32_t)(total_cycles / (MICRO_ITERATIONS * MICRO_OPS_PER_ITERATION * 5));
    printf("RESULT:MICRO:FP_OPS avg_cycles=%u iterations=%d\n", avg_cycles, MICRO_ITERATIONS * MICRO_OPS_PER_ITERATION * 5);
}

static void run_micro_fp_div(struct eml_timing_ctx *ctx)
{
    struct eml_timing_sample sample;
    uint64_t total_cycles = 0;
    volatile float result = 0.0f;
    float x;

    /* Benchmark: FP division (known 14-cycle operation on Cortex-M4F) */
    for (int i = 0; i < MICRO_ITERATIONS; i++) {
        x = (float)micro_test_int + (float)(i + 1);

        eml_timing_start(ctx, &sample);
        for (int j = 0; j < MICRO_OPS_PER_ITERATION; j++) {
            result = x / (float)(j + 1);
            x = result + (float)micro_test_int;
        }
        eml_timing_stop(ctx, &sample);

        total_cycles += eml_timing_cycles(ctx, &sample);
        __asm__ volatile("" : : "r"(result) : "memory");
    }

    uint32_t avg_cycles = (uint32_t)(total_cycles / (MICRO_ITERATIONS * MICRO_OPS_PER_ITERATION));
    printf("RESULT:MICRO:FP_DIV avg_cycles=%u iterations=%d\n", avg_cycles, MICRO_ITERATIONS * MICRO_OPS_PER_ITERATION);
}

static void run_micro_benchmarks(struct eml_timing_ctx *ctx)
{
#ifdef CONFIG_EMLEARN_BENCHMARK_STRUCTURED_OUTPUT
    printf("BENCHMARK:MICRO_START\n");
#else
    printf("\n=== Micro-benchmarks ===\n");
#endif

    run_micro_int_ops(ctx);
    run_micro_fp_ops(ctx);
    run_micro_fp_div(ctx);
    run_micro_expf(ctx);
    run_micro_sigmoid(ctx);

#ifdef CONFIG_EMLEARN_BENCHMARK_STRUCTURED_OUTPUT
    printf("BENCHMARK:MICRO_END\n");
#else
    printf("\n");
#endif
}

#endif /* CONFIG_EMLEARN_BENCHMARK_MICRO */

/* predict_proba output length. Inline GBT models require the exact class
 * count, so prefer BENCHMARK_MODEL_N_CLASSES from the generated test-data
 * header and only fall back to the buffer size when it is not provided. */
#ifdef BENCHMARK_MODEL_N_CLASSES
#define BENCHMARK_PROBA_LENGTH BENCHMARK_MODEL_N_CLASSES
#else
#define BENCHMARK_PROBA_LENGTH EMTREES_MAX_CLASSES
#endif

/* Maximum classes for predict_proba buffer */
#ifndef EMTREES_MAX_CLASSES
#define EMTREES_MAX_CLASSES 30
#endif

static int run_benchmark(void)
{
    struct eml_timing_ctx timing_ctx;
    struct eml_timing_sample sample;
    struct benchmark_stats stats;
#ifdef CONFIG_EMLEARN_BENCHMARK_PREDICT_PROBA
    float probas[EMTREES_MAX_CLASSES];
    int proba_err;
#else
    int prediction;
#endif
    int ret;

    /* Mark end of boot phase (for trace analysis) */
    marker_boot_end();

    /* Initialize timing */
    ret = eml_timing_init(&timing_ctx);
    if (ret < 0) {
        printf("ERROR: Failed to initialize timing\n");
        return ret;
    }

#ifdef CONFIG_EMLEARN_BENCHMARK_STRUCTURED_OUTPUT
    printf("BENCHMARK:START\n");
    printf("BENCHMARK:CONFIG board=%s timing=%s freq=%u\n",
           CONFIG_BOARD,
           eml_timing_mode_str(timing_ctx.mode),
           timing_ctx.cpu_freq_hz);
    printf("BENCHMARK:MODEL name=benchmark_model features=%d samples=%d\n",
           BENCHMARK_MODEL_N_FEATURES,
           BENCHMARK_MODEL_N_SAMPLES);
#else
    printf("\n=== emlearn Benchmark ===\n");
    printf("Board: %s\n", CONFIG_BOARD);
    printf("Timing: %s @ %u Hz\n", eml_timing_mode_str(timing_ctx.mode), timing_ctx.cpu_freq_hz);
    printf("Model: benchmark_model\n");
    printf("Features: %d\n", BENCHMARK_MODEL_N_FEATURES);
    printf("Test samples: %d\n", BENCHMARK_MODEL_N_SAMPLES);
    printf("Warmup iterations: %d\n", CONFIG_EMLEARN_BENCHMARK_WARMUP);
    printf("Benchmark iterations: %d\n", CONFIG_EMLEARN_BENCHMARK_ITERATIONS);
    printf("\n");
#endif

#ifdef CONFIG_EMLEARN_BENCHMARK_MICRO
    /* Run micro-benchmarks before main benchmark */
    run_micro_benchmarks(&timing_ctx);
#endif

    /* Mark start of warmup phase */
    marker_warmup_start();

    /* Warmup - run inference without timing to warm caches */
#ifndef CONFIG_EMLEARN_BENCHMARK_STRUCTURED_OUTPUT
    printf("Running warmup...\n");
#endif
    for (int i = 0; i < CONFIG_EMLEARN_BENCHMARK_WARMUP; i++) {
        int sample_idx = i % BENCHMARK_MODEL_N_SAMPLES;
#ifdef CONFIG_EMLEARN_BENCHMARK_PREDICT_PROBA
        proba_err = benchmark_model_predict_proba(benchmark_model_test_data[sample_idx],
                                                   BENCHMARK_MODEL_N_FEATURES,
                                                   probas, BENCHMARK_PROBA_LENGTH);
        if (proba_err != 0) {
            /* A failing predict_proba returns in a few cycles and would be
             * reported as a very fast inference. Fail the run instead. */
            printf("ERROR: predict_proba returned %d (out_length=%d)\n",
                   proba_err, BENCHMARK_PROBA_LENGTH);
            return -1;
        }
#else
        prediction = benchmark_model_predict(benchmark_model_test_data[sample_idx],
                                             BENCHMARK_MODEL_N_FEATURES);
        (void)prediction;  /* suppress unused warning */
#endif
    }

    /* Mark end of warmup phase */
    marker_warmup_end();

    /* Benchmark - time each inference */
#ifndef CONFIG_EMLEARN_BENCHMARK_STRUCTURED_OUTPUT
    printf("Running benchmark...\n");
#endif
    stats_init(&stats);

    /* Marker for GDB-controlled trace start */
    benchmark_loop_start();

    /* Mark start of benchmark phase (same as benchmark_loop_start for now) */
    marker_benchmark_start();

    for (int i = 0; i < CONFIG_EMLEARN_BENCHMARK_ITERATIONS; i++) {
        int sample_idx = i % BENCHMARK_MODEL_N_SAMPLES;
        const float *features = benchmark_model_test_data[sample_idx];

        barrier_dmem_fence_full();  /* Complete pending memory operations */
        eml_timing_start(&timing_ctx, &sample);
#ifdef CONFIG_EMLEARN_BENCHMARK_PREDICT_PROBA
        proba_err = benchmark_model_predict_proba(features, BENCHMARK_MODEL_N_FEATURES,
                                                   probas, BENCHMARK_PROBA_LENGTH);
#else
        prediction = benchmark_model_predict(features, BENCHMARK_MODEL_N_FEATURES);
#endif
        eml_timing_stop(&timing_ctx, &sample);
        barrier_dmem_fence_full();  /* Ensure timing read completes */

        uint32_t elapsed_ns = eml_timing_ns(&timing_ctx, &sample);
        uint32_t elapsed_cycles = eml_timing_cycles(&timing_ctx, &sample);
        stats_update(&stats, elapsed_ns, elapsed_cycles);

        /* Use result to prevent compiler from optimizing away inference.
         * The asm volatile with memory clobber ensures the compiler cannot
         * eliminate the benchmark call as dead code. */
#ifdef CONFIG_EMLEARN_BENCHMARK_PREDICT_PROBA
        __asm__ volatile("" : : "m"(probas) : "memory");
        (void)proba_err;
#else
        __asm__ volatile("" : : "r"(prediction) : "memory");
#endif
    }

    /* Mark end of benchmark phase */
    marker_benchmark_end();

    /* Marker for GDB-controlled trace end */
    benchmark_loop_end();

    /* Report results */
#ifdef CONFIG_EMLEARN_BENCHMARK_STRUCTURED_OUTPUT
    stats_print_structured(&stats, "INFERENCE");
    printf("BENCHMARK:END status=ok\n");
#else
    printf("\n");
    stats_print_legacy(&stats, "inference");
    printf("\n=== Benchmark Complete ===\n");
#endif

    return 0;
}

int main(void)
{
#ifndef CONFIG_EMLEARN_BENCHMARK_STRUCTURED_OUTPUT
    printf("\nemlearn Zephyr Benchmark\n");
    printf("Tick rate: %d Hz\n", CONFIG_SYS_CLOCK_TICKS_PER_SEC);
#endif

    int ret = run_benchmark();

#ifdef CONFIG_EMLEARN_BENCHMARK_STRUCTURED_OUTPUT
    if (ret != 0) {
        printf("BENCHMARK:END status=error code=%d\n", ret);
    }
#endif

    return ret;
}
```

## src/eml_mcu_timing.h
```c
/*
 * MCU Timing Abstraction for emlearn benchmarks
 *
 * Provides a unified interface for timing measurements across different
 * ARM Cortex-M variants:
 * - DWT cycle counter (Cortex-M3+): cycle-accurate
 * - Systick (Cortex-M0/M0+): microsecond resolution via k_cyc_to_us_*
 *
 * Configuration via Kconfig:
 * - CONFIG_EMLEARN_TIMING_DWT: Use DWT cycle counter (default on M3+)
 * - CONFIG_EMLEARN_TIMING_SYSTICK: Use systick via Zephyr kernel
 */

#ifndef EML_MCU_TIMING_H
#define EML_MCU_TIMING_H

#include <zephyr/kernel.h>
#include <stdint.h>

#ifdef CONFIG_EMLEARN_TIMING_DWT
#include "eml_benchmark.h"
#endif

#ifdef CONFIG_EMLEARN_TIMING_POSIX
#include <sys/time.h>
#endif

#ifdef __cplusplus
extern "C" {
#endif

/* Timing mode enumeration */
typedef enum {
    EML_TIMING_SYSTICK,
    EML_TIMING_DWT,
    EML_TIMING_POSIX,
} eml_timing_mode_t;

/* Timing context - stores configuration for a timing session */
struct eml_timing_ctx {
    eml_timing_mode_t mode;
    uint32_t cpu_freq_hz;  /* For DWT cycle->time conversion */
};

/* Timing sample - raw timing data before conversion */
struct eml_timing_sample {
    uint32_t start;
    uint32_t end;
#ifdef CONFIG_EMLEARN_TIMING_POSIX
    uint64_t start_us;  /* POSIX: microseconds from gettimeofday */
    uint64_t end_us;
#endif
};

/**
 * Initialize timing context.
 * Detects available timing hardware and initializes it.
 *
 * @param ctx Timing context to initialize
 * @return 0 on success, negative on error
 */
static inline int eml_timing_init(struct eml_timing_ctx *ctx) {
    ctx->cpu_freq_hz = CONFIG_SYS_CLOCK_HW_CYCLES_PER_SEC;

#ifdef CONFIG_EMLEARN_TIMING_POSIX
    ctx->mode = EML_TIMING_POSIX;
    ctx->cpu_freq_hz = 1000000000;  /* Report as 1GHz for cycle display */
    return 0;
#endif

#ifdef CONFIG_EMLEARN_TIMING_DWT
#ifdef EML_HAVE_DWT
    if (eml_dwt_init() == 0) {
        ctx->mode = EML_TIMING_DWT;
        /* DWT counts CPU cycles, not system clock ticks.
         * Use dedicated config since SYS_CLOCK_HW_CYCLES_PER_SEC
         * may reflect RTC frequency (e.g., 32768 Hz on nRF52). */
        ctx->cpu_freq_hz = CONFIG_EMLEARN_DWT_CPU_FREQ_HZ;
        return 0;
    }
#endif
#endif

    /* Fall back to systick */
    ctx->mode = EML_TIMING_SYSTICK;
    return 0;
}

/**
 * Get timing mode name string.
 */
static inline const char *eml_timing_mode_str(eml_timing_mode_t mode) {
    switch (mode) {
        case EML_TIMING_DWT:     return "dwt";
        case EML_TIMING_SYSTICK: return "systick";
        case EML_TIMING_POSIX:   return "posix";
        default:                 return "unknown";
    }
}

#ifdef CONFIG_EMLEARN_TIMING_POSIX
static inline uint64_t eml_posix_gettime_us(void) {
    struct timeval tv;
    gettimeofday(&tv, NULL);
    return (uint64_t)tv.tv_sec * 1000000ULL + (uint64_t)tv.tv_usec;
}
#endif

/**
 * Start timing measurement.
 */
static inline void eml_timing_start(const struct eml_timing_ctx *ctx,
                                    struct eml_timing_sample *sample) {
#ifdef CONFIG_EMLEARN_TIMING_POSIX
    if (ctx->mode == EML_TIMING_POSIX) {
        sample->start_us = eml_posix_gettime_us();
        return;
    }
#endif
#ifdef CONFIG_EMLEARN_TIMING_DWT
    if (ctx->mode == EML_TIMING_DWT) {
        sample->start = eml_dwt_cycles();
        return;
    }
#endif
    sample->start = k_cycle_get_32();
}

/**
 * Stop timing measurement.
 */
static inline void eml_timing_stop(const struct eml_timing_ctx *ctx,
                                   struct eml_timing_sample *sample) {
#ifdef CONFIG_EMLEARN_TIMING_POSIX
    if (ctx->mode == EML_TIMING_POSIX) {
        sample->end_us = eml_posix_gettime_us();
        return;
    }
#endif
#ifdef CONFIG_EMLEARN_TIMING_DWT
    if (ctx->mode == EML_TIMING_DWT) {
        sample->end = eml_dwt_cycles();
        return;
    }
#endif
    sample->end = k_cycle_get_32();
}

/**
 * Get elapsed time in CPU cycles.
 */
static inline uint32_t eml_timing_cycles(const struct eml_timing_ctx *ctx,
                                         const struct eml_timing_sample *sample) {
#ifdef CONFIG_EMLEARN_TIMING_POSIX
    if (ctx->mode == EML_TIMING_POSIX) {
        /* Return microseconds * 1000 as "cycles" for POSIX mode (pseudo-ns) */
        return (uint32_t)((sample->end_us - sample->start_us) * 1000);
    }
#endif
    (void)ctx;
    return sample->end - sample->start;
}

/**
 * Get elapsed time in microseconds.
 */
static inline uint32_t eml_timing_us(const struct eml_timing_ctx *ctx,
                                     const struct eml_timing_sample *sample) {
#ifdef CONFIG_EMLEARN_TIMING_POSIX
    if (ctx->mode == EML_TIMING_POSIX) {
        return (uint32_t)(sample->end_us - sample->start_us);
    }
#endif

    uint32_t cycles = sample->end - sample->start;

#ifdef CONFIG_EMLEARN_TIMING_DWT
    if (ctx->mode == EML_TIMING_DWT) {
        return eml_cycles_to_us(cycles, ctx->cpu_freq_hz);
    }
#endif

    return k_cyc_to_us_floor32(cycles);
}

/**
 * Get elapsed time in nanoseconds.
 */
static inline uint32_t eml_timing_ns(const struct eml_timing_ctx *ctx,
                                     const struct eml_timing_sample *sample) {
#ifdef CONFIG_EMLEARN_TIMING_POSIX
    if (ctx->mode == EML_TIMING_POSIX) {
        /* gettimeofday only has microsecond precision */
        return (uint32_t)((sample->end_us - sample->start_us) * 1000);
    }
#endif

    uint32_t cycles = sample->end - sample->start;

#ifdef CONFIG_EMLEARN_TIMING_DWT
    if (ctx->mode == EML_TIMING_DWT) {
        return eml_cycles_to_ns(cycles, ctx->cpu_freq_hz);
    }
#endif

    return k_cyc_to_ns_floor32(cycles);
}

#ifdef __cplusplus
}
#endif

#endif /* EML_MCU_TIMING_H */
```
